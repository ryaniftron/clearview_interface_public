#include "cv_repartition.h"

// https://www.esp32.com/viewtopic.php?f=13&t=12004

//Goal: Change OTA size to 1.5Mb instead of 1Mb

#include <stdio.h>
#include "freertos/FreeRTOS.h"
#include "esp_err.h"
#include "esp_ota_ops.h"
// #include "nvs_flash.h"
// #include "nvs.h"
#include <esp_log.h>

const size_t CP_BUF_SZ = 2048;
const char* TAG = "cv_repartition";


const char partitions_1_5_nofactory_bin[0x2000] = {
  0XAA, 0X50, 0X01, 0X02, 0X00, 0X90, 0X00, 0X00, 0X00, 0X40, 0X00, 0X00,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 0X00,
  0XAA, 0X50, 0X01, 0X01, 0X00, 0XF0, 0X00, 0X00, 0X00, 0X10, 0X00, 0X00,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 0X00,
  0XAA, 0X50, 0X00, 0X11, 0X00, 0X00, 0X19, 0X00, 0X00, 0X70, 0X17, 0X00,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 0XFE,
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  0XFF, 0XFF, 0XFF, 0XFF, 0XFF, 0XFF, 0XFF, 0XFF, 0XFF, 0XFF, 0XFF, 0XFF,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 0XFF
};


static void write_partition_table(const char *new_table){
    esp_err_t ret = spi_flash_erase_range(CONFIG_PARTITION_TABLE_OFFSET, 0x2000);
    if(ret == ESP_OK){
        spi_flash_write(CONFIG_PARTITION_TABLE_OFFSET, new_table, 0x2000);
        // nvs_flash_erase();
        // nvs_flash_init();
        esp_restart();
    }
}

// Copies partition contents from src to dst
static void duplicate_partition(esp_partition_t *src, esp_partition_t *dst){
    //TODO
}   


// This function is called when a factory partition exists
extern void alter_default_partitions() {

    esp_partition_subtype_t FACTORY = ESP_PARTITION_SUBTYPE_DATA_OTA;
    esp_partition_subtype_t OTA0 = ESP_PARTITION_SUBTYPE_APP_OTA_0;
    esp_partition_subtype_t OTA1 = ESP_PARTITION_SUBTYPE_APP_OTA_1;

    const esp_partition_t *boot_partition = esp_ota_get_running_partition();
    ESP_LOGE(TAG, "Current running partition: %s", boot_partition->label);
    if(boot_partition->subtype == FACTORY){ // This should not happen in the wild
        ESP_LOGW(TAG, "Running from Factory partition. Rewriting table now.");
        // Clear OTA0 and OTA1
        const esp_partition_t *ota0 = esp_partition_find_first(ESP_PARTITION_TYPE_APP, OTA0, "ota_0");
        if (ota0 != NULL){
            //ESP_ERROR_CHECK(esp_partition_erase_range(ota0, ota0->address, ota0->size));
            ESP_ERROR_CHECK(spi_flash_erase_range(ota0->address,ota0->size));
        } else {
            ESP_LOGE(TAG, "No OTA0 partition to erase");
            return;
        }
        const esp_partition_t *ota1 = esp_partition_find_first(ESP_PARTITION_TYPE_APP, OTA1, "ota_1");
        if (ota1 != NULL){
            //ESP_ERROR_CHECK(esp_partition_erase_range(ota1, CONFIG_PARTITION_TABLE_OFFSET, ota1->size));
            ESP_ERROR_CHECK(spi_flash_erase_range(ota1->address, ota1->size));
        } else {
            ESP_LOGE(TAG, "No OTA1 partition to erase");
            return;
        }
        ESP_LOGI(TAG, "Done erase, now rewriting partition table");
        // Write new part table
        write_partition_table(partitions_1_5_nofactory_bin);        
    } else if(boot_partition->subtype == OTA0){
        ESP_LOGI(TAG, "On OTA0 now. Erasing factory, copying over ota0, then booting factory");
        const esp_partition_t *fp = esp_partition_find_first(ESP_PARTITION_TYPE_APP, FACTORY, "factory");
        ESP_ERROR_CHECK(esp_partition_erase_range(fp,  CONFIG_PARTITION_TABLE_OFFSET, fp->size));
        ESP_LOGE(TAG, "TODO copy ota0 over");
        ESP_LOGE(TAG, "TODO boot to factory");
    }
    else if(boot_partition->subtype == OTA1){
        ESP_LOGW(TAG, "On OTA1 now. XXX");
        const esp_partition_t *fp = esp_partition_find_first(ESP_PARTITION_TYPE_APP, FACTORY, "factory");
        ESP_ERROR_CHECK(esp_partition_erase_range(fp,  CONFIG_PARTITION_TABLE_OFFSET, fp->size));
        ESP_LOGE(TAG, "TODO copy ota1 over");
        ESP_LOGE(TAG, "TODO boot to factory");
    }
}

// // This function is called if the factory partition is missing
// // This means we are at least partially upgraded, so we need to check
// // the size of ota_1 to see if the upgrade is completed.
// void check_upgraded_partitions() {
//     const esp_partition_t *ota_0 = esp_partition_find_first(ESP_PARTITION_TYPE_APP, 16, "ota_0");
//     const esp_partition_t *ota_1 = esp_partition_find_first(ESP_PARTITION_TYPE_APP, 17, "ota_1");
//     if(ota_0->size == 1536000 && ota_1->size == 1536000){
//         ESP_LOGI("repartition", "Fully upgraded partition table");
//     }
//     else if(ota_0->size == 1536000 && ota_1->size == 1048576){
//         const esp_partition_t *boot_partition = esp_ota_get_running_partition();
//         ESP_LOGW("repartition", "Partially upgraded table");
//         if(boot_partition->subtype == 16){
//             ESP_LOGW("repartition", "Running from OTA0, write final table");
//             write_partition_table(final_table);
//         }
//         else if(boot_partition->subtype == 17){
//             ESP_LOGI("repartition", "Running from OTA1, wait until next update");
//         }
//     }
// }

void repartition_device() {
    const esp_partition_t *factory_partition = esp_partition_find_first(ESP_PARTITION_TYPE_APP, 00, "factory");
    const esp_partition_t *ota_0 = esp_partition_find_first(ESP_PARTITION_TYPE_APP, 16, "ota_0");
    const esp_partition_t *ota_1 = esp_partition_find_first(ESP_PARTITION_TYPE_APP, 17, "ota_1");
    if(factory_partition != NULL){
        ESP_LOGI(TAG, "Default partition scheme detected");
        alter_default_partitions();
    }
    // if(factory_partition == NULL && ota_0 != NULL && ota_1 != NULL){
    //     ESP_LOGI("repartition", "Modified partition scheme detected");
    //     check_upgraded_partitions();
    // }
}