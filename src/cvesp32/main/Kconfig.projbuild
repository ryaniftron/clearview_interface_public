## src/cvesp32/main/Kconfig.projbuild
```kconfig
menu "ClearView ESP32 Configuration"

    config ESP_WIFI_SSID
        string "ESP32 SoftAP Fallback SSID (typically overwritten on boot)"
        default "esp_softap_ssid"
        help
            Fallback SSID (network name) for the ESP to generate when in HotSpot Mode. 
            ClearView typically overwrites it with the serial number of the ESP32.

    config ESP_WIFI_PASSWORD
        string "ESP32 SoftAP Password (Leave empty for unsecured)"
        default ""
        help
            Password to join the ESP HotSpot Network.
            Leave it empty for an unsecured hotspot. 

    config ESP_MAX_STA_CONN
        int "Maximal station connections"
        default 4
        range 1 4
        help
            Max number of the STA connects to AP.

    config NETWORK_SSID
        string "Network SSID of the network to connect to as a station/client"
        default "network_ssid"
        help
            SSID (network name) of the network the ESP would like to join as a client in station mode

    config NETWORK_PASSWORD
        string "WiFi Password of the network to connect to as a station/client"
        default "network_password"
        help
            WiFi password of the network the ESP would like to join as a client in station mode

    config BROKER_IP
        string "MQTT Broker IP. Examples are 'localhost' or '192.168.88.18'"
        default "localhost"
        help 
            The IP address of the MQTT Broker. Set to the IP address of the computer running the MQTT broker

    config FRIENDLY_NAME
        string "Friendly Name of ESP32"
        default "MyESP32_Name"
        help
            The easy to read name of the ESP32

    config SEAT_NUMBER
        int "Default seat number for startup. Range 0-7"
        default 0
        range 0 7
        help
            Which seat number between 0 and 7 (inclusive) the unit starts on

    menu "Enable and Disable CV Features"

        config ENABLE_SERIAL
            bool "Enable Serial Communication"
            default y
        
        config HW_VERSION_IFTRON_A
            bool "Iftron Hardware RevA"
            default n
            depends on ENABLE_SERIAL
            select ESP_CONSOLE_UART_NONE 
            # select ESP_CONSOLE_UART_DEFAULT if HW_VERSION_IFTRON_A=n

            # ESP_CONSOLE_NONE
            # ESP_CONSOLE_UART_DEFAULT
            
        config ENABLE_LED
            bool "Enable LED codes"
            default y
        
        choice 
            prompt "Allowed WiFi Modes. Can Disable Wifi"
            optional
            default y 
            config SOFTAP_ALLOWED
                bool "Only Allow SoftAP WiFi"
                default n
            config STA_ALLOWED
                bool "Only Allow Station WiFi"
                default n
            config BOTH_WIFI_ALLOWED
                bool "Both WiFi Modes Allowed"
                default y
        endchoice

        if SOFTAP_ALLOWED || STA_ALLOWED || BOTH_WIFI_ALLOWED # Wifi is on
            if BOTH_WIFI_ALLOWED
                choice 
                    prompt "Startup Wifi Mode"
                    
                    config STARTUP_WIFI_SOFTAP
                        bool "Start in SoftAP"
                        default n

                    config STARTUP_WIFI_STA
                        bool "Start in STA"
                        default n

                    config STARTUP_STA_IF_CREDS_ELSE_SOFTAP
                        bool "Start in STA if valid WiFi Creds otherwise SoftAP"
                        default y
                endchoice
            endif # BOTH_WIFI_ALLOWED

        # MQTT can run if STA or both allowed
        if STA_ALLOWED || BOTH_WIFI_ALLOWED
            config ENABLE_MQTT
                bool "Enable MQTT"
                default y
        endif # STA_ALLOWED || BOTH_WIFI_ALLOWED

            choice 
                prompt "Web Server"
                optional
                default y
                #if BOTH_WIFI_ALLOWED           # If all three choices use if/endif, Web Server is never available
                config WEB_SERVER_BOTH
                    bool "Allowed in Both Modes"
                    default y
                    depends on BOTH_WIFI_ALLOWED # Need to use depend here for some reason
                #endif # BOTH_WIFI_ALLOWED
                
                if BOTH_WIFI_ALLOWED || SOFTAP_ALLOWED
                    config WEB_SERVER_SOFTAP_ONLY
                        bool "Only in SoftAP"
                        default y
                endif # BOTH_WIFI_ALLOWED || SOFTAP_ALLOWED
                
                if BOTH_WIFI_ALLOWED || STA_ALLOWED
                    config WEB_SERVER_STA_ONLY
                        bool "Only in STA"
                        default n
                endif  # BOTH_WIFI_ALLOWED || STA_ALLOWED
            endchoice
                
        endif # SOFTAP_ALLOWED || STA_ALLOWED || BOTH_WIFI_ALLOWED # Wifi is on
        
        config CV_INITIAL_PROGRAM
            bool "Enable Initial Firmware Program Version"
            default n
            # help "Turn this on to make the module include more programming and test"

    endmenu 
        
endmenu 
```

## src/cvesp32/sdkconfig.defaults
```kconfig
CONFIG_ENABLE_SERIAL=y
CONFIG_ENABLE_LED=y
CONFIG_BOTH_WIFI_ALLOWED=y
CONFIG_STARTUP_WIFI_SOFTAP=y
CONFIG_ENABLE_MQTT=y
CONFIG_WEB_SERVER_SOFTAP_ONLY=y
CONFIG_EXAMPLE_CONNECT_WIFI=y
CONFIG_ESP32_WIFI_NVS_ENABLED=n
CONFIG_ESP32_PHY_CALIBRATION_AND_DATA_STORAGE=n
CONFIG_HTTPD_MAX_REQ_HDR_LEN=1024

#OTA
CONFIG_PARTITION_TABLE_TWO_OTA=y
CONFIG_OTA_ALLOW_HTTP=y
CONFIG_ESPTOOLPY_FLASHSIZE_4MB=y

#These are enabled for Iftron Production
CONFIG_HW_VERSION_IFTRON_A=y
CONFIG_CONSOLE_UART_NONE=y
```

## src/cvesp32/sdkconfig.defaults_production
```kconfig
CONFIG_ENABLE_SERIAL=y
CONFIG_ENABLE_LED=y
CONFIG_CVLED_PIN_IFTRONA=y
CONFIG_BOTH_WIFI_ALLOWED=y
CONFIG_STARTUP_WIFI_SOFTAP=y
CONFIG_ENABLE_MQTT=y
CONFIG_WEB_SERVER_SOFTAP_ONLY=y
CONFIG_EXAMPLE_CONNECT_WIFI=y
CONFIG_ESP32_WIFI_NVS_ENABLED=n
CONFIG_ESP32_PHY_CALIBRATION_AND_DATA_STORAGE=n
CONFIG_HTTPD_MAX_REQ_HDR_LEN=1024

#OTA
CONFIG_PARTITION_TABLE_TWO_OTA=y
CONFIG_OTA_ALLOW_HTTP=y
CONFIG_ESPTOOLPY_FLASHSIZE_4MB=y

#These are enabled for Iftron Production
CONFIG_HW_VERSION_IFTRON_A=y
CONFIG_ESP_CONSOLE_UART_NONE=y
CONFIG_CV_INITIAL_PROGRAM=n

#Memory Saving
CONFIG_NEWLIB_NANO_FORMAT=y
# TODO try mbedtls and removing other secure options
```
